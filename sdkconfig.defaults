## sdkconfig.defaults
```kconfig
# 目标芯片：P4（不写这行会默认 esp32，编译出来烧不进 P4）
CONFIG_IDF_TARGET="esp32p4"

# ---- FreeRTOS：为了让"运行时间统计"可用 ----
# 这两个是本次实验的关键开关，作用见 L2 讲解
CONFIG_FREERTOS_GENERATE_RUN_TIME_STATS=y
CONFIG_FREERTOS_USE_TRACE_FACILITY=y
CONFIG_FREERTOS_VTASKLIST_INCLUDE_COREID=y

# ---- 日志 ----
CONFIG_LOG_DEFAULT_LEVEL_INFO=y

# ---- 栈溢出检测（先埋个伏笔，L4 会用到）----
CONFIG_FREERTOS_CHECK_STACKOVERFLOW_CANARY=y

# ---- 主任务栈 ----
CONFIG_ESP_MAIN_TASK_STACK_SIZE=4096

# 崩溃时停在 GDB Stub，而不是重启（D1 调试用）
CONFIG_ESP_SYSTEM_GDBSTUB_RUNTIME=y
CONFIG_ESP_GDBSTUB_SUPPORT_TASKS=y

# 主控制台走 USB-Serial/JTAG（GDB Stub 也走这个通道，调试必需）
CONFIG_ESP_CONSOLE_USB_SERIAL_JTAG=y

# ---- P6: P4 + C6 Wi-Fi（esp-hosted over SDIO）----
# 从 p4function 的 sdkconfig 抄来（同一块 P4X-Function-EV-Board）
# CONFIG_ESP_HOST_WIFI_ENABLED is not set
CONFIG_ESP_HOSTED_ENABLED=y
CONFIG_ESP_HOSTED_CP_TARGET_ESP32C6=y
# CONFIG_ESP_HOSTED_CP_TARGET_ESP32H2 is not set
# CONFIG_ESP_HOSTED_CP_TARGET_ESP32H4 is not set
CONFIG_ESP_HOSTED_PRIV_ENABLE_WIFI_OPTIONS=y
CONFIG_ESP_HOSTED_IDF_SLAVE_TARGET="esp32c6"
CONFIG_ESP_HOSTED_P4_DEV_BOARD_NONE=y
# CONFIG_ESP_HOSTED_P4_DEV_BOARD_FUNC_BOARD is not set
# CONFIG_ESP_HOSTED_P4_C6_CORE_BOARD is not set
CONFIG_ESP_HOSTED_PRIV_SDIO_OPTION=y
CONFIG_ESP_HOSTED_PRIV_SPI_HD_OPTION=y
# CONFIG_ESP_HOSTED_SPI_HOST_INTERFACE is not set
CONFIG_ESP_HOSTED_SDIO_HOST_INTERFACE=y
# CONFIG_ESP_HOSTED_SPI_HD_HOST_INTERFACE is not set
# CONFIG_ESP_HOSTED_UART_HOST_INTERFACE is not set
CONFIG_ESP_HOSTED_SDIO_RESET_ACTIVE_HIGH=y
# CONFIG_ESP_HOSTED_SDIO_RESET_ACTIVE_LOW is not set
# CONFIG_ESP_HOSTED_SDIO_OPTIMIZATION_RX_NONE is not set
# CONFIG_ESP_HOSTED_SDIO_OPTIMIZATION_RX_MAX_SIZE is not set
CONFIG_ESP_HOSTED_SDIO_OPTIMIZATION_RX_STREAMING_MODE=y
# CONFIG_ESP_HOSTED_SDIO_SLOT_0 is not set
CONFIG_ESP_HOSTED_SDIO_SLOT_1=y
CONFIG_ESP_HOSTED_SDIO_SLOT=1
CONFIG_ESP_HOSTED_SD_PWR_CTRL_LDO_INTERNAL_IO=y
CONFIG_ESP_HOSTED_SD_PWR_CTRL_LDO_IO_ID=4
CONFIG_ESP_HOSTED_SDIO_4_BIT_BUS=y
# CONFIG_ESP_HOSTED_SDIO_1_BIT_BUS is not set
CONFIG_ESP_HOSTED_SDIO_BUS_WIDTH=4
CONFIG_ESP_HOSTED_SDIO_CLOCK_FREQ_KHZ=40000
CONFIG_ESP_HOSTED_SDIO_CMD_GPIO_RANGE_MIN=0
CONFIG_ESP_HOSTED_SDIO_CMD_GPIO_RANGE_MAX=100
CONFIG_ESP_HOSTED_SDIO_CLK_GPIO_RANGE_MIN=0
CONFIG_ESP_HOSTED_SDIO_CLK_GPIO_RANGE_MAX=100
CONFIG_ESP_HOSTED_SDIO_D0_GPIO_RANGE_MIN=0
CONFIG_ESP_HOSTED_SDIO_D0_GPIO_RANGE_MAX=100
CONFIG_ESP_HOSTED_SDIO_D1_GPIO_RANGE_MIN=0
CONFIG_ESP_HOSTED_SDIO_D1_GPIO_RANGE_MAX=100
CONFIG_ESP_HOSTED_SDIO_D2_GPIO_RANGE_MIN=0
CONFIG_ESP_HOSTED_SDIO_D2_GPIO_RANGE_MAX=100
CONFIG_ESP_HOSTED_SDIO_D3_GPIO_RANGE_MIN=0
CONFIG_ESP_HOSTED_SDIO_D3_GPIO_RANGE_MAX=100
CONFIG_ESP_HOSTED_SDIO_RESET_SLAVE_GPIO_MIN=0
CONFIG_ESP_HOSTED_SDIO_RESET_SLAVE_GPIO_MAX=100
CONFIG_ESP_HOSTED_PRIV_SDIO_PIN_CMD_SLOT_1=19
CONFIG_ESP_HOSTED_PRIV_SDIO_PIN_CLK_SLOT_1=18
CONFIG_ESP_HOSTED_PRIV_SDIO_PIN_D0_SLOT_1=14
CONFIG_ESP_HOSTED_PRIV_SDIO_PIN_D1_4BIT_BUS_SLOT_1=15
CONFIG_ESP_HOSTED_PRIV_SDIO_PIN_D2_4BIT_BUS_SLOT_1=16
CONFIG_ESP_HOSTED_PRIV_SDIO_PIN_D3_4BIT_BUS_SLOT_1=17
CONFIG_ESP_HOSTED_SDIO_GPIO_RESET_SLAVE=54
CONFIG_ESP_HOSTED_SDIO_PIN_CMD=19
CONFIG_ESP_HOSTED_SDIO_PIN_CLK=18
CONFIG_ESP_HOSTED_SDIO_PIN_D0=14
CONFIG_ESP_HOSTED_SDIO_PRIV_PIN_D1_4BIT_BUS=15
CONFIG_ESP_HOSTED_SDIO_PIN_D2=16
CONFIG_ESP_HOSTED_SDIO_PIN_D3=17
CONFIG_ESP_HOSTED_SDIO_PIN_D1=15
CONFIG_ESP_HOSTED_SDIO_TX_Q_SIZE=20
CONFIG_ESP_HOSTED_SDIO_RX_Q_SIZE=20
CONFIG_ESP_HOSTED_SDIO_RESET_DELAY_MS=1500
# CONFIG_ESP_HOSTED_SDIO_CHECKSUM is not set
CONFIG_ESP_HOSTED_SLAVE_RESET_ON_EVERY_HOST_BOOTUP=y
# CONFIG_ESP_HOSTED_SLAVE_RESET_ONLY_IF_NECESSARY is not set
CONFIG_ESP_HOSTED_GPIO_SLAVE_RESET_SLAVE=54
CONFIG_ESP_HOSTED_RPC_TASK_STACK=4096
CONFIG_ESP_HOSTED_DFLT_TASK_STACK=3072
# CONFIG_ESP_HOSTED_DFLT_TASK_FROM_SPIRAM is not set
CONFIG_ESP_HOSTED_TRANSPORT_RESTART_ON_FAILURE=y
CONFIG_ESP_HOSTED_MEM_MONITOR=y
CONFIG_ESP_HOSTED_ENABLE_ITWT=y
# CONFIG_ESP_HOSTED_WIFI_AUTO_CONNECT_ON_STA_START is not set
# CONFIG_ESP_HOSTED_ENABLE_GPIO_EXPANDER is not set
# CONFIG_ESP_HOSTED_CP_EXT_COEX is not set
# CONFIG_ESP_HOSTED_ENABLE_DPP is not set
CONFIG_ESP_HOSTED_USE_MEMPOOL=y
CONFIG_ESP_HOSTED_MAX_SIMULTANEOUS_SYNC_RPC_REQUESTS=5
CONFIG_ESP_HOSTED_MAX_SIMULTANEOUS_ASYNC_RPC_REQUESTS=5
CONFIG_ESP_HOSTED_CLI_ENABLED=y
# CONFIG_ESP_HOSTED_CLI_NEW_INSTANCE is not set
# CONFIG_ESP_HOSTED_FW_VERSION_MISMATCH_WARNING_SUPPRESS is not set
# CONFIG_ESP_HOSTED_RAW_THROUGHPUT_TRANSPORT is not set
# CONFIG_ESP_HOSTED_PKT_STATS is not set
CONFIG_ESP_HOSTED_HOST_TO_ESP_WIFI_DATA_THROTTLE=y
CONFIG_ESP_HOSTED_PRIV_WIFI_TX_SDIO_HIGH_THRESHOLD=80
CONFIG_ESP_HOSTED_TO_WIFI_DATA_THROTTLE_HIGH_THRESHOLD=80
CONFIG_ESP_HOSTED_TO_WIFI_DATA_THROTTLE_LOW_THRESHOLD=60
CONFIG_ESP_HOSTED_ENABLE_PEER_DATA_TRANSFER=y
CONFIG_ESP_HOSTED_MAX_CUSTOM_MSG_HANDLERS=3
# CONFIG_ESP_HOSTED_DECODE_WIFI_RESERVED_FIELD is not set
# CONFIG_ESP_HOSTED_NETWORK_SPLIT_ENABLED is not set
# CONFIG_ESP_HOSTED_HOST_POWER_SAVE_ENABLED is not set
CONFIG_ESP_WIFI_REMOTE_ENABLED=y
CONFIG_ESP_WIFI_REMOTE_IDF_SPECIFIC_ADDED=y
# CONFIG_SLAVE_IDF_TARGET_ESP32 is not set
# CONFIG_SLAVE_IDF_TARGET_ESP32S2 is not set
# CONFIG_SLAVE_IDF_TARGET_ESP32C3 is not set
# CONFIG_SLAVE_IDF_TARGET_ESP32S3 is not set
# CONFIG_SLAVE_IDF_TARGET_ESP32C2 is not set
CONFIG_SLAVE_IDF_TARGET_ESP32C6=y
# CONFIG_SLAVE_IDF_TARGET_ESP32C5 is not set
# CONFIG_SLAVE_IDF_TARGET_ESP32C61 is not set
CONFIG_SLAVE_IDF_TARGET_ARCH_RISCV=y
CONFIG_ESP_WIFI_REMOTE_LIBRARY_HOSTED=y
# CONFIG_ESP_WIFI_REMOTE_LIBRARY_EPPP is not set
# CONFIG_ESP_WIFI_REMOTE_LIBRARY_CUSTOM is not set
CONFIG_ESP_WIFI_REMOTE_EAP_ENABLED=y
```
